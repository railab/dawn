## boards/arm/nrf52/nrf52840-dk/Kconfig
```kconfig
#
# For a description of the syntax of this configuration file,
# see the file kconfig-language.txt in the NuttX tools repository.
#

config DAWN_NRF52840DK_OVERLAY
	bool
	default y
	select ARCH_HAVE_LEDS
	select ARCH_HAVE_BUTTONS
	select ARCH_HAVE_IRQBUTTONS
	---help---
		Enable the Dawn nrf52840dk board overlay defaults.

config NRF52840DK_BTNLEDS_GPIO
	bool "Export board LEDS and BUTTONS as GPIO"
	default n
	depends on !ARCH_LEDS && !ARCH_BUTTONS && GPIO_LOWER_HALF && DEV_GPIO
	---help---
		Export board LEDS and buttons as GPIOs.

# Include common fake drivers Kconfig
# DAWN_BOARDS_COMMON is set by dawn/CMakeLists.txt (processed before Kconfig)
source "$(DAWN_BOARDS_COMMON)/Kconfig"
```

## boards/arm/nrf52/nrf52840-dk/configs/blinky_buttons/defconfig
```kconfig
# CONFIG_ARCH_FPU is not set
# CONFIG_ARCH_LEDS is not set
# CONFIG_NRF52840DK_BTNLEDS_GPIO is not set
CONFIG_ARCH="arm"
CONFIG_ARCH_BOARD_COMMON=y
CONFIG_ARCH_BOARD_CUSTOM=y
CONFIG_ARCH_BOARD_CUSTOM_DIR="../../boards/arm/nrf52/nrf52840-dk/"
CONFIG_ARCH_BOARD_CUSTOM_DIR_RELPATH=y
CONFIG_ARCH_BOARD_CUSTOM_NAME="nrf52840-dk"
CONFIG_ARCH_BUTTONS=y
CONFIG_ARCH_IRQBUTTONS=y
CONFIG_ARCH_CHIP="nrf52"
CONFIG_ARCH_CHIP_NRF52840=y
CONFIG_ARCH_CHIP_NRF52=y
CONFIG_ARCH_STACKDUMP=y
CONFIG_ARCH_STDARG_H=y
CONFIG_BOARDCTL=y
CONFIG_BOARD_LOOPSPERMSEC=5500
CONFIG_BUILTIN=y
CONFIG_CXX_LOCALIZATION=y
CONFIG_CXX_WCHAR=y
CONFIG_DEBUG_ASSERTIONS=y
CONFIG_DEBUG_ASSERTIONS_EXPRESSION=y
CONFIG_DEBUG_FEATURES=y
CONFIG_DEBUG_FULLOPT=y
CONFIG_DEBUG_SYMBOLS=y
CONFIG_DEV_GPIO=y
CONFIG_FS_PROCFS=y
CONFIG_GPIO_LOWER_HALF=y
CONFIG_HAVE_CXX=y
CONFIG_INIT_ENTRYPOINT="dawn_main"
CONFIG_INIT_STACKSIZE=10240
CONFIG_INPUT=y
CONFIG_INPUT_BUTTONS=y
CONFIG_INPUT_BUTTONS_LOWER=y
CONFIG_IOEXPANDER=y
CONFIG_LIBCXX=y
CONFIG_LIBCXXABI=y
CONFIG_LIBC_LOCALE=y
CONFIG_MM_REGIONS=2
CONFIG_NDEBUG=y
CONFIG_NRF52_GPIOTE=y
CONFIG_NRF52_UART0=y
CONFIG_PREALLOC_MQ_MSGS=32
CONFIG_PREALLOC_TIMERS=4
CONFIG_RAM_SIZE=262144
CONFIG_RAM_START=0x20000000
CONFIG_RAW_BINARY=y
CONFIG_RR_INTERVAL=200
CONFIG_SCHED_WAITPID=y
CONFIG_SIG_EVTHREAD=y
CONFIG_START_DAY=26
CONFIG_START_MONTH=3
CONFIG_SYMTAB_ORDEREDBYNAME=y
CONFIG_TASK_NAME_SIZE=32
CONFIG_TLS_NELEM=4
CONFIG_UART0_SERIAL_CONSOLE=y
CONFIG_USERLED=y
CONFIG_USERLED_LOWER=y
#include "defconfig.dawn"
```

## boards/arm/nrf52/nrf52840-dk/configs/nimble_sensor_producer/defconfig
```kconfig
# CONFIG_ARCH_FPU is not set
# CONFIG_NIMBLE_PORTING_EXAMPLE is not set
# CONFIG_WIRELESS_BLUETOOTH_HOST is not set
CONFIG_ALLOW_BSDNORDIC_COMPONENTS=y
CONFIG_ALLOW_BSD_COMPONENTS=y
CONFIG_ARCH="arm"
CONFIG_ARCH_BOARD_COMMON=y
CONFIG_ARCH_BOARD_CUSTOM=y
CONFIG_ARCH_BOARD_CUSTOM_DIR="../../boards/arm/nrf52/nrf52840-dk/"
CONFIG_ARCH_BOARD_CUSTOM_DIR_RELPATH=y
CONFIG_ARCH_BOARD_CUSTOM_NAME="nrf52840-dk"
CONFIG_ARCH_CHIP="nrf52"
CONFIG_ARCH_CHIP_NRF52840=y
CONFIG_ARCH_CHIP_NRF52=y
CONFIG_BOARDCTL=y
CONFIG_BUILTIN=y
CONFIG_CXX_LOCALIZATION=y
CONFIG_CXX_WCHAR=y
CONFIG_DEBUG_SYMBOLS=y
CONFIG_EXAMPLES_USENSOR_READER=y
CONFIG_EXAMPLES_USENSOR_READER_STACKSIZE=4096
CONFIG_FS_PROCFS=y
CONFIG_HAVE_CXX=y
CONFIG_INIT_ENTRYPOINT="nsh_main"
CONFIG_INTELHEX_BINARY=y
CONFIG_LIBCXX=y
CONFIG_LIBCXXABI=y
CONFIG_LIBC_FLOATINGPOINT=y
CONFIG_LIBC_LOCALE=y
CONFIG_NET=y
CONFIG_NET_BLUETOOTH=y
CONFIG_NETDEV_LATEINIT=y
CONFIG_NETUTILS_NETINIT=y
CONFIG_NIMBLE=y
CONFIG_NIMBLE_L2CAP_COC_MAX_NUM=1
CONFIG_NIMBLE_ROLE_PERIPHERAL=y
CONFIG_NRF52_SOFTDEVICE_CONTROLLER=y
CONFIG_NRF52_UART0=y
CONFIG_NSH_BUILTIN_APPS=y
CONFIG_NSH_READLINE=y
CONFIG_PREALLOC_MQ_MSGS=32
CONFIG_PREALLOC_TIMERS=4
CONFIG_RAM_SIZE=262144
CONFIG_RAM_START=0x20000000
CONFIG_RAW_BINARY=y
CONFIG_SENSORS=y
CONFIG_SIG_EVTHREAD=y
CONFIG_SYSTEM_NSH=y
CONFIG_TLS_NELEM=4
CONFIG_UART0_SERIAL_CONSOLE=y
CONFIG_USENSOR=y
CONFIG_WIRELESS=y
CONFIG_WIRELESS_BLUETOOTH=y
#include "defconfig.dawn"
```

## boards/arm/nrf54l/nrf54lm20-dk/Kconfig
```kconfig
#
# For a description of the syntax of this configuration file,
# see the file kconfig-language.txt in the NuttX tools repository.
#

# Include common fake drivers Kconfig
# DAWN_BOARDS_COMMON is set by dawn/CMakeLists.txt (processed before Kconfig)
source "$(DAWN_BOARDS_COMMON)/Kconfig"
```

## boards/arm/nrf91/thingy91/Kconfig
```kconfig
#
# For a description of the syntax of this configuration file,
# see the file kconfig-language.txt in the NuttX tools repository.
#

if ARCH_BOARD_THINGY91

endif

# The Thingy:91 has one user button (P0.26) with interrupt support via
# GPIOTE.  This board is normally built as a custom board (ARCH_BOARD_CUSTOM),
# so advertise the button capability here rather than via the in-tree
# boards/Kconfig entry.

config ARCH_HAVE_BUTTONS
	bool
	default y

config ARCH_HAVE_IRQBUTTONS
	bool
	default y
```

## boards/arm/stm32c0/nucleo-c092rc/Kconfig
```kconfig
#
# For a description of the syntax of this configuration file,
# see the file kconfig-language.txt in the NuttX tools repository.
#

config DAWN_NUCLEOC092RC_OVERLAY
	bool
	default y
	select ARCH_HAVE_LEDS
	select ARCH_HAVE_BUTTONS
	select ARCH_HAVE_IRQBUTTONS
	select ARCH_BUTTONS
	select ARCH_IRQBUTTONS
	---help---
		Enable the Dawn board overlay defaults for the Nucleo-C092RC.
```

## boards/arm/stm32f0l0g0/nucleo-c071rb/Kconfig
```kconfig
#
# For a description of the syntax of this configuration file,
# see the file kconfig-language.txt in the NuttX tools repository.
#

config DAWN_NUCLEOC071RB_OVERLAY
	bool
	default y
	select ARCH_HAVE_LEDS
	select ARCH_HAVE_BUTTONS
	select ARCH_HAVE_IRQBUTTONS
	select ARCH_BUTTONS
	select ARCH_IRQBUTTONS
	---help---
		Enable the Dawn board overlay defaults for the Nucleo-C071RB.
```

## boards/arm/stm32h7/nucleo-h743zi/Kconfig
```kconfig
#
# Dawn nucleo-h743zi Kconfig
#

config DAWN_APPS_NUCLEO-H743ZI
    bool "Dawn nucleo-h743zi application"
    default n
    depends on DAWN
    ---help---
        Enable Dawn application for nucleo-h743zi.

if DAWN_APPS_NUCLEO-H743ZI

config DAWN_APPS_NUCLEO-H743ZI_DESC_YAML_PATH
    string "Dawn descriptor YAML path"
    default ""
    depends on DAWN_APPS_NUCLEO-H743ZI
    ---help---
        Path to the YAML descriptor file relative to the project root.

endif # DAWN_APPS_NUCLEO-H743ZI
```

## boards/common/Kconfig
```kconfig
#
# For a description of the syntax of this configuration file,
# see the file kconfig-language.txt in the NuttX tools repository.
#
# NOTE: This file serves as the canonical source for fake driver Kconfig
# options. Any board (internal or external) can include these drivers by
# adding to their board Kconfig:
#
#   source "$(DAWN_BOARDS_COMMON)/Kconfig"
#
# The DAWN_BOARDS_COMMON environment variable is set by dawn/CMakeLists.txt
# during the apps processing phase (before Kconfig runs), making it available
# to all boards regardless of their location.
#

menu "Dawn Fake Drivers (for testing and simulation)"

config DAWN_FAKE_DRIVERS
	bool "Enable fake drivers for testing and simulation"
	default n
	---help---
		Enable fake/mock drivers for testing and simulation purposes.
		These drivers provide simulated hardware behavior without requiring
		real peripherals, useful for development, testing, and CI/CD.

if DAWN_FAKE_DRIVERS

config DAWN_FAKE_ADC
	bool "Fake ADC driver"
	default n
	depends on ADC
	---help---
		Enable the fake ADC driver for tests and simulation.

config DAWN_FAKE_DAC
	bool "Fake DAC driver"
	default n
	depends on DAC
	---help---
		Enable the fake DAC driver for tests and simulation.

config DAWN_FAKE_PWM
	bool "Fake PWM driver"
	default n
	depends on PWM
	---help---
		Enable the fake PWM driver for tests and simulation.

config DAWN_FAKE_ENCODER
	bool "Fake encoder driver"
	default n
	depends on SENSORS_QENCODER
	---help---
		Enable the fake quadrature encoder driver for tests and simulation.

config DAWN_FAKE_IOEXPANDER
	bool "Fake GPIO I/O Expander driver"
	default n
	depends on GPIO_LOWER_HALF && IOEXPANDER
	select IOEXPANDER_DUMMY
	---help---
		Enable the fake GPIO expander driver for tests and simulation.

config DAWN_FAKE_SENSORS
	bool "Fake sensor driver"
	default n
	depends on SENSORS
	---help---
		Enable fake sensor devices for tests and simulation.

config DAWN_FAKE_USERLEDS
	bool "Fake user LED driver"
	default n
	depends on USERLED
	---help---
		Enable the fake user LED driver for tests and simulation.

config DAWN_FAKE_RGBLED
	bool "Fake RGB LED driver"
	default n
	depends on RGBLED && PWM
	depends on PWM_NCHANNELS >= 3
	---help---
		Enable a fake /dev/rgbledN character driver for tests and simulation.
		The fake device registers NuttX's RGBLED upper half backed by fake
		PWM lower halves, so it accepts the same #RRGGBB writes as a board
		RGB LED device.

config DAWN_FAKE_BUTTONS
	bool "Fake button driver"
	default n
	depends on INPUT_BUTTONS
	---help---
		Enable the fake button driver for tests and simulation.

config DAWN_FAKE_UID
	bool "Fake unique ID support"
	default n
	depends on BOARDCTL_UNIQUEID
	---help---
		Provide a fake board unique ID for tests and simulation.

config DAWN_FAKE_RESET
	bool "Fake reset support"
	default n
	depends on ARCH_HAVE_RESET
	---help---
		Provide a fake reset handler for tests and simulation.

config DAWN_FAKE_POWEROFF
	bool "Fake poweroff support"
	default n
	depends on ARCH_HAVE_POWEROFF
	---help---
		Provide a fake poweroff handler for tests and simulation.

config DAWN_FAKE_FILES
	bool "Fake files in tmpfs"
	default n
	depends on FS_TMPFS
	---help---
		Pre-populate a small set of canned files in tmpfs at board
		bringup, so that file-IO bindings (CIOFile) and transports such
		as the NimBLE Object Transfer Service have content to transfer
		without requiring any real persistent storage on the board.

if DAWN_FAKE_FILES

config DAWN_FAKE_FILES_MOUNTPOINT
	string "Fake files mount point"
	default "/tmp"
	---help---
		Directory in which the fake files are created. Must already be
		mounted (typically tmpfs) before dawn_fake_files_init() runs.

config DAWN_FAKE_FILE_RO
	bool "Read-only fake file"
	default n
	---help---
		Create a read-only fake file at <mountpoint>/some_file_ro.txt
		populated with the string "initial data".

config DAWN_FAKE_FILE_RW
	bool "Read-write fake file"
	default n
	---help---
		Create a read-write fake file at <mountpoint>/some_file_rw.txt
		populated with the string "initial data".

endif # DAWN_FAKE_FILES

endif # DAWN_FAKE_DRIVERS

endmenu
```

## boards/sim/sim/sim/Kconfig
```kconfig
#
# For a description of the syntax of this configuration file,
# see the file kconfig-language.txt in the NuttX tools repository.
#

config DAWN_SIM_OVERLAY
	bool
	default y
	select ARCH_HAVE_RESET
	select BOARDCTL_UNIQUEID
	---help---
		Enable the Dawn simulator board overlay defaults.

config DAWN_SIM_TTY_ALIAS
	bool "Alias /dev/ttyS1 to the sim host PTY (CONFIG_SIM_UART0_NAME)"
	default n
	select PSEUDOFS_SOFTLINKS
	---help---
		Create a VFS symlink /dev/ttyS1 -> CONFIG_SIM_UART0_NAME at
		bringup so descriptor YAML can hardcode the canonical NuttX
		serial path /dev/ttyS1 and run unmodified on both real boards
		and the simulator.

# Include common fake drivers Kconfig
# DAWN_BOARDS_COMMON is set by dawn/CMakeLists.txt (processed before Kconfig)
source "$(DAWN_BOARDS_COMMON)/Kconfig"
```

## boards/sim/sim/sim/configs/nsh_usensor_can/defconfig
```kconfig
CONFIG_ARCH="sim"
CONFIG_ARCH_BOARD_CUSTOM=y
CONFIG_ARCH_BOARD_CUSTOM_DIR="../../boards/sim/sim/sim/"
CONFIG_ARCH_BOARD_CUSTOM_DIR_RELPATH=y
CONFIG_ARCH_BOARD_CUSTOM_NAME="sim"
CONFIG_ARCH_CHIP="sim"
CONFIG_ARCH_SIM=y
CONFIG_BOARDCTL=y
CONFIG_BOARD_LOOPSPERMSEC=0
CONFIG_BUILTIN=y
CONFIG_CAN=y
CONFIG_CAN_EXTID=y
CONFIG_CAN_LOOPBACK=y
CONFIG_CXX_LOCALIZATION=y
CONFIG_DEBUG_ASSERTIONS=y
CONFIG_DEBUG_ASSERTIONS_EXPRESSION=y
CONFIG_DEBUG_FEATURES=y
CONFIG_DEBUG_SYMBOLS=y
CONFIG_EXAMPLES_USENSOR_READER=y
CONFIG_EXAMPLES_USENSOR_READER_STACKSIZE=4096
CONFIG_HAVE_CXX=y
CONFIG_INIT_ENTRYNAME="nsh_main"
CONFIG_INIT_ENTRYPOINT="nsh_main"
CONFIG_INIT_STACKSIZE=10240
CONFIG_LIBCXX=y
CONFIG_LIBCXXABI=y
CONFIG_LIBC_FLOATINGPOINT=y
CONFIG_LIBC_LOCALE=y
CONFIG_NSH_BUILTIN_APPS=y
CONFIG_NSH_READLINE=y
CONFIG_SCHED_WAITPID=y
CONFIG_SENSORS=y
CONFIG_SIM_CANDEV=y
CONFIG_SIM_CANDEV_CHAR=y
CONFIG_SYSTEM_NSH=y
CONFIG_SYSTEM_READLINE=y
CONFIG_TIMER_FD=y
CONFIG_TIMER_FD_POLL=y
CONFIG_TLS_NELEM=4
CONFIG_USENSOR=y
#include "defconfig.dawn"
```

## dawn/apps/Kconfig
```kconfig
#
# For a description of the syntax of this configuration file,
# see the file kconfig-language.txt in the NuttX tools repository.
#

source "$APPSDIR/external/apps/dawn/Kconfig"

# Optional Dawn app-extension Kconfig. dawnpy may export this to point at
# a project-provided app registry before the first Kconfig pass runs.
orsource "$(DAWN_EXTENSION_APPS_KCONFIG)"
```
