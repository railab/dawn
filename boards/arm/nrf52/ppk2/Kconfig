## boards/arm/stm32f4/stm32f4discovery/configs/modbus_tcp_ntfc/defconfig
```kconfig
# CONFIG_ARCH_LEDS is not set
CONFIG_ARCH="arm"
CONFIG_ARCH_BOARD_CUSTOM=y
CONFIG_ARCH_BOARD_CUSTOM_DIR="../../boards/arm/stm32f4/stm32f4discovery/"
CONFIG_ARCH_BOARD_CUSTOM_DIR_RELPATH=y
CONFIG_ARCH_BOARD_CUSTOM_NAME="stm32f4discovery"
CONFIG_ARCH_BOARD_STM32F4_DISCOVERY=y
CONFIG_ARCH_BUTTONS=y
CONFIG_ARCH_CHIP="stm32f4"
CONFIG_ARCH_CHIP_STM32=y
CONFIG_ARCH_CHIP_STM32F407VG=y
CONFIG_ARCH_CHIP_STM32F4=y
CONFIG_ARCH_FPU=y
CONFIG_ARCH_IRQBUTTONS=y
CONFIG_ARCH_STACKDUMP=y
CONFIG_BOARDCTL=y
CONFIG_BOARD_LATE_INITIALIZE=y
CONFIG_BOARD_LOOPSPERMSEC=16717
CONFIG_BUILTIN=y
CONFIG_CDCECM_EPBULKIN=1
CONFIG_CDCECM_EPBULKOUT=2
CONFIG_CDCECM_EPINTIN=3
CONFIG_CXX_LOCALIZATION=y
CONFIG_CXX_WCHAR=y
CONFIG_DEBUG_FULLOPT=y
CONFIG_DEBUG_SYMBOLS=y
CONFIG_DEV_NULL=y
CONFIG_FS_TMPFS=y
CONFIG_HAVE_CXX=y
CONFIG_HAVE_CXXINITIALIZE=y
CONFIG_INDUSTRY_NXMODBUS=y
CONFIG_INIT_ENTRYPOINT="nsh_main"
CONFIG_INIT_STACKSIZE=4096
CONFIG_INPUT=y
CONFIG_INPUT_BUTTONS=y
CONFIG_INPUT_BUTTONS_LOWER=y
CONFIG_INTELHEX_BINARY=y
CONFIG_IOB_NBUFFERS=36
CONFIG_LIBCXX=y
CONFIG_LIBCXXABI=y
CONFIG_LIBC_FLOATINGPOINT=y
CONFIG_LIBC_LOCALE=y
CONFIG_LINE_MAX=64
CONFIG_MM_REGIONS=2
CONFIG_NET=y
CONFIG_NET_BROADCAST=y
CONFIG_NET_CDCECM=y
CONFIG_NET_ETH_PKTSIZE=1514
CONFIG_NET_ICMP=y
CONFIG_NET_ICMP_SOCKET=y
CONFIG_NET_SOCKOPTS=y
CONFIG_NET_STATISTICS=y
CONFIG_NET_TCP=y
CONFIG_NET_UDP=y
CONFIG_NETDEV_LATEINIT=y
CONFIG_NETINIT_DRIPADDR=0xa9fe0001
CONFIG_NETINIT_IPADDR=0xa9fe0702
CONFIG_NETINIT_NETMASK=0xffff0000
CONFIG_NETINIT_NOMAC=y
CONFIG_NETUTILS_NETINIT=y
CONFIG_NSH_BUILTIN_APPS=y
CONFIG_NSH_READLINE=y
CONFIG_NXMODBUS_SERVER=y
CONFIG_NXMODBUS_TCP=y
CONFIG_RAM_SIZE=114688
CONFIG_RAM_START=0x20000000
CONFIG_RAW_BINARY=y
CONFIG_RR_INTERVAL=200
CONFIG_SCHED_LPWORK=y
CONFIG_SCHED_WAITPID=y
CONFIG_START_DAY=27
CONFIG_START_MONTH=6
CONFIG_START_YEAR=2013
CONFIG_STDIO_DISABLE_BUFFERING=y
CONFIG_STM32_JTAG_SW_ENABLE=y
CONFIG_STM32_OTGFS=y
CONFIG_STM32_PWR=y
CONFIG_STM32_USART2=y
CONFIG_SYSTEM_NSH=y
CONFIG_TLS_NELEM=4
CONFIG_USART2_SERIAL_CONSOLE=y
CONFIG_USBDEV=y
CONFIG_USERLED=y
CONFIG_USERLED_LOWER=y
#include "defconfig.dawn"
```

## boards/arm/stm32f4/stm32f4discovery/configs/nxscope/defconfig
```kconfig
# CONFIG_ARCH_LEDS is not set
CONFIG_ARCH="arm"
CONFIG_ARCH_BOARD_CUSTOM=y
CONFIG_ARCH_BOARD_CUSTOM_DIR="../../boards/arm/stm32f4/stm32f4discovery/"
CONFIG_ARCH_BOARD_CUSTOM_DIR_RELPATH=y
CONFIG_ARCH_BOARD_CUSTOM_NAME="stm32f4discovery"
CONFIG_ARCH_BOARD_STM32F4_DISCOVERY=y
CONFIG_ARCH_BUTTONS=y
CONFIG_ARCH_CHIP="stm32f4"
CONFIG_ARCH_CHIP_STM32=y
CONFIG_ARCH_CHIP_STM32F407VG=y
CONFIG_ARCH_CHIP_STM32F4=y
CONFIG_ARCH_FPU=y
CONFIG_ARCH_IRQBUTTONS=y
CONFIG_ARCH_STACKDUMP=y
CONFIG_BOARDCTL=y
CONFIG_BOARD_LATE_INITIALIZE=y
CONFIG_BOARD_LOOPSPERMSEC=16717
CONFIG_BUILTIN=y
CONFIG_CDCACM=y
CONFIG_CDCACM_RXBUFSIZE=256
CONFIG_CDCACM_TXBUFSIZE=2048
CONFIG_CXX_LOCALIZATION=y
CONFIG_CXX_WCHAR=y
CONFIG_DEBUG_FULLOPT=y
CONFIG_DEBUG_SYMBOLS=y
CONFIG_DEV_NULL=y
CONFIG_HAVE_CXX=y
CONFIG_HAVE_CXXINITIALIZE=y
CONFIG_INIT_ENTRYPOINT="dawn_main"
CONFIG_INIT_STACKSIZE=8192
CONFIG_INPUT=y
CONFIG_INPUT_BUTTONS=y
CONFIG_INPUT_BUTTONS_LOWER=y
CONFIG_INTELHEX_BINARY=y
CONFIG_LIBCXX=y
CONFIG_LIBCXXABI=y
CONFIG_LIBC_FLOATINGPOINT=y
CONFIG_LIBC_LOCALE=y
CONFIG_LINE_MAX=64
CONFIG_LOGGING_NXSCOPE=y
CONFIG_LOGGING_NXSCOPE_ACKFRAMES=y
CONFIG_LOGGING_NXSCOPE_DIVIDER=y
CONFIG_LOGGING_NXSCOPE_INTF_SERIAL=y
CONFIG_LOGGING_NXSCOPE_PROTO_SER=y
CONFIG_MM_REGIONS=2
CONFIG_RAM_SIZE=114688
CONFIG_RAM_START=0x20000000
CONFIG_RAW_BINARY=y
CONFIG_RR_INTERVAL=200
CONFIG_SCHED_HPWORK=y
CONFIG_SCHED_LPWORK=y
CONFIG_SCHED_WAITPID=y
CONFIG_SENSORS=y
CONFIG_SENSORS_LIS3DSH_UORB=y
CONFIG_SENSORS_LIS3DSH_UORB_POLL=y
CONFIG_SENSORS_LIS3DSH_UORB_POLL_INTERVAL=100000
CONFIG_SERIAL_TERMIOS=y
CONFIG_SPI=y
CONFIG_START_DAY=27
CONFIG_START_MONTH=6
CONFIG_START_YEAR=2013
CONFIG_STDIO_DISABLE_BUFFERING=y
CONFIG_STM32_JTAG_SW_ENABLE=y
CONFIG_STM32_OTGFS=y
CONFIG_STM32_PWR=y
CONFIG_STM32_SPI1=y
CONFIG_STM32_USART2=y
CONFIG_TLS_NELEM=4
CONFIG_UORB=y
CONFIG_USART2_SERIAL_CONSOLE=y
CONFIG_USBDEV=y
CONFIG_USERLED=y
CONFIG_USERLED_LOWER=y
#include "defconfig.dawn"
```

## dawn/apps/dawn/Kconfig
```kconfig
#
# For a description of the syntax of this configuration file,
# see the file kconfig-language.txt in the NuttX tools repository.
#

config DAWN_APPS_DAWN
	bool "Dawn main application"
	default n
	---help---
		Build the main Dawn application entry point.

if DAWN_APPS_DAWN

config DAWN_APPS_DAWN_STACKSIZE
	int "Dawn app stack size"
	default DEFAULT_TASK_STACKSIZE
	---help---
		Set the worker stack size for the Dawn application task.

config DAWN_APPS_DESC_SOURCE_BUILTIN
	bool "Built-in descriptor (compiled into app)"
	default y
	---help---
		Compile the descriptor into the app binary via
		g_dawn_desc[]. This is the default behaviour.
		Can be used together with DAWN_APPS_DESC_SOURCE_FILE to
		support both built-in and file-based descriptors.

config DAWN_APPS_DESC_SOURCE_FILE
	bool "File-based descriptor (-f <path>)"
	default n
	---help---
		Enable loading a descriptor from a binary file at startup
		via ``-f <path>``. Can be used together with
		DAWN_APPS_DESC_SOURCE_BUILTIN to support both sources.
		When both are enabled, ``-f`` overrides the built-in
		descriptor; without ``-f`` the built-in is used.

config DAWN_APPS_DESC_FILE_MAX_SIZE
	int "Max descriptor file size (bytes)"
	default 4096
	depends on DAWN_APPS_DESC_SOURCE_FILE
	---help---
		Maximum size in bytes for a descriptor binary loaded from a
		file. Files larger than this are rejected at startup.

choice
	prompt "Dawn descriptor source format"
	default DAWN_APPS_EXAMPLE_DESC_FORMAT_CXX

config DAWN_APPS_EXAMPLE_DESC_FORMAT_CXX
	bool "C++ descriptor path (CONFIG_DAWN_APPS_EXAMPLE_DESC_PATH)"
	---help---
		Use pre-generated C++ descriptor file from
		CONFIG_DAWN_APPS_EXAMPLE_DESC_PATH.

config DAWN_APPS_EXAMPLE_DESC_FORMAT_YAML
	bool "YAML descriptor path (generated at build time)"
	---help---
		Generate descriptor.cxx from YAML using dawnpy during build.

endchoice

config DAWN_APPS_EXAMPLE_DESC_PATH
	string "DAWN_APPS_EXAMPLE_DESC_PATH"
	depends on DAWN_APPS_EXAMPLE_DESC_FORMAT_CXX
	---help---
		Path to descriptor.cxx descriptor file.

config DAWN_APPS_EXAMPLE_DESC_YAML_PATH
	string "DAWN_APPS_EXAMPLE_DESC_YAML_PATH"
	depends on DAWN_APPS_EXAMPLE_DESC_FORMAT_YAML
	---help---
		Path to descriptor YAML file used for build-time generation.

endif
```
