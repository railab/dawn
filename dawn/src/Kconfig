## dawn/src/system/Kconfig
```kconfig
#
# Dawn OBJTYPE_ANY objects
#

config DAWN_SYSTEM_LTE
	bool "LTE connectivity object"
	default n
	depends on LTE_LAPI
	---help---
		LTE connectivity as an OBJTYPE_ANY object. Holds the APN / auth /
		IP-type parameters as config items reachable from a Config IO;
		start()/stop() bring the data connection up/down through the
		common NuttX LTE API (lapi).

if DAWN_SYSTEM_LTE

config DAWN_SYSTEM_LTE_APN
	string "Default LTE APN (empty: network/SIM default)"
	default ""

config DAWN_SYSTEM_LTE_USERNAME
	string "Default LTE APN username"
	default ""

config DAWN_SYSTEM_LTE_PASSWORD
	string "Default LTE APN password"
	default ""

config DAWN_SYSTEM_LTE_AUTHTYPE
	int "Default LTE auth type (0=none, 1=PAP, 2=CHAP)"
	default 0
	range 0 2

config DAWN_SYSTEM_LTE_IPTYPE
	int "Default LTE IP type (0=IPv4, 1=IPv6, 2=IPv4/IPv6)"
	default 0
	range 0 2

config DAWN_SYSTEM_LTE_REG_TIMEOUT
	int "Default LTE registration timeout (seconds)"
	default 120

config DAWN_SYSTEM_LTE_PSAVE
	int "Default LTE power-save mode (0=none, 1=PSM, 2=eDRX)"
	default 0
	range 0 2
	---help---
		Power-save mode requested at attach, applied through the NuttX LTE
		API (lapi):
		  0 = none  - PSM and eDRX disabled; the device stays reachable for
		              server-initiated requests (highest power).
		  1 = PSM   - Power Saving Mode; lowest power, the device is reachable
		              only in brief windows (store-and-forward / queue mode).
		  2 = eDRX  - extended DRX; balanced reachability and power.
		The network must grant the requested mode.

endif # DAWN_SYSTEM_LTE

config DAWN_SYSTEM_GNSS
	bool "GNSS coexistence manager"
	default n
	depends on DAWN_IO_SENSOR && LTE_LAPI
	---help---
		Userspace GNSS/LTE coexistence policy as an OBJTYPE_ANY object. A
		monitor thread watches GNSS for a fix and drives the radio knobs the
		kernel exposes (GNSS priority via SNIOC_GNSS_SET_PRIORITY, LTE
		power-save via the LTE API). The kernel provides only the mechanisms;
		this object owns the policy.

if DAWN_SYSTEM_GNSS

config DAWN_SYSTEM_GNSS_ENABLED
	bool "Start with GNSS enabled"
	default n
	---help---
		Runtime on/off default for the GNSS manager. When n (default) the
		device boots LTE-only and GNSS stays idle until a server enables it
		over LwM2M (IPSO Actuation 3306/5850 bound to the manager's 'enabled'
		config item). When y, GNSS runs from boot. The descriptor 'enabled'
		field overrides this.

config DAWN_SYSTEM_GNSS_MODE
	int "Default GNSS coexistence mode (0=off, 1=hybrid)"
	default 1
	range 0 1
	---help---
		Coexistence policy applied at start:
		  0 = off    - the manager does not touch the radio knobs; LTE only.
		  1 = hybrid - LTE first: once LTE is up, the manager borrows the radio
		               in bounded windows (LTE PSM + GNSS priority) to land a
		               cold fix, and always hands it back afterwards so LTE
		               stays reachable even when no fix is possible (indoors).

config DAWN_SYSTEM_GNSS_SETTLE
	int "Seconds to wait for LTE before the first GNSS attempt"
	default 60
	range 0 600
	---help---
		LTE-first grace period. The manager waits up to this long for LTE to
		report CONNECTED before borrowing the radio for GNSS, so the device
		registers and becomes reachable first. Capped so a permanently-down
		LTE never blocks GNSS forever.

config DAWN_SYSTEM_GNSS_ACQUIRE
	int "Bounded GNSS acquisition window (seconds)"
	default 360
	range 30 1200
	---help---
		Maximum time a single fix attempt holds the radio (LTE asleep in PSM,
		GNSS priority). On expiry the radio is handed back to LTE whether or
		not a fix landed, so LTE is never starved indefinitely. Must exceed a
		typical cold TTFF (~208s open-sky, no assistance) so a single window
		can complete a cold fix - the receiver goes cold during the cooldown
		between windows, so a too-short window never converges.

config DAWN_SYSTEM_GNSS_RETRY
	int "LTE-reachable cooldown between GNSS attempts (seconds)"
	default 300
	range 0 7200
	---help---
		After a failed (no-fix) acquisition window the manager stays out of the
		radio for this long, keeping LTE reachable, before trying again. A
		successful fix ends the loop entirely.

config DAWN_SYSTEM_GNSS_MAXATTEMPTS
	int "Consecutive no-fix windows before giving up"
	default 0
	range 0 1000
	---help---
		0 = never give up: keep retrying forever (registration-safe loop;
		ensure the LwM2M lifetime exceeds acquire+retry). >0 = after this many
		failed windows, stop borrowing the radio and park fully on LTE, then
		re-arm after GNSS_REARM seconds. Useful for mostly-indoor devices that
		must stay reachable.

config DAWN_SYSTEM_GNSS_REARM
	int "Re-arm delay after giving up (seconds)"
	default 3600
	range 0 86400
	---help---
		When GNSS_MAXATTEMPTS is reached the manager waits this long - LTE fully
		reachable, no PSM, no GNSS priority - before re-arming and trying GNSS
		again. Only used when GNSS_MAXATTEMPTS > 0.

endif # DAWN_SYSTEM_GNSS
```

## dawn/tests/Kconfig
```kconfig
#
# For a description of the syntax of this configuration file,
# see the file kconfig-language.txt in the NuttX tools repository.
#

config DAWN_TESTS
	bool "Enable DAWN unit tests"
	default n
	---help---
		Build and enable the Dawn unit test application.

if DAWN_TESTS

config DAWN_TESTS_STACKSIZE
	int "Dawn test app stack size"
	default DEFAULT_TASK_STACKSIZE
	---help---
		Set the worker stack size for the test application.

config DAWN_TEST_EXIT_ON_FAIL
	bool "Stop test on the first failure"
	default n
	---help---
		Stop the test run immediately after the first failing check.

endif # DAWN_TESTS
```

## examples/apps/Kconfig
```kconfig
#
# examples/apps/Kconfig
#
# SPDX-License-Identifier: Apache-2.0
#

menu "Dawn example applications"

source "$APPSDIR/external/examples/apps/usensor_reader/Kconfig"

endmenu
```

## examples/apps/usensor_reader/Kconfig
```kconfig
#
# For a description of the syntax of this configuration file,
# see the file kconfig-language.txt in the NuttX tools repository.
#

config EXAMPLES_USENSOR_READER
	tristate "User sensor reader example"
	default n
	depends on SENSORS
	---help---
		Build the usensor_reader example app used to validate that
		non-Dawn applications can consume user sensor topics produced
		by Dawn.

if EXAMPLES_USENSOR_READER

config EXAMPLES_USENSOR_READER_STACKSIZE
	int "User sensor reader stack size"
	default 4096

endif
```

## examples/out-of-tree-demo/boards/sim/sim/sim/Kconfig
```kconfig
#
# examples/out-of-tree-demo/boards/sim/sim/sim/Kconfig
#
# SPDX-License-Identifier: Apache-2.0
#

config DAWN_OOT_DEMO_OVERLAY
	bool
	default y
	select ARCH_HAVE_RESET
	select BOARDCTL_UNIQUEID
	---help---
	  Enable the Dawn out-of-tree demo board overlay defaults.

# Common fake-driver Kconfig (shared with the upstream sim board).
source "$(DAWN_BOARDS_COMMON)/Kconfig"

# User-extension Kconfig owned by the OOT project.
source "$(DAWN_OOT_ROOT)/external/src/io/Kconfig"
source "$(DAWN_OOT_ROOT)/external/src/prog/Kconfig"
source "$(DAWN_OOT_ROOT)/external/src/proto/Kconfig"
```

## examples/out-of-tree-demo/boards/sim/sim/sim/configs/nsh_user_shell_yaml/defconfig
```kconfig
#
# Out-of-tree demo: NSH + Dawn shell with user IO/PROG/PROTO factories.
#
CONFIG_ARCH="sim"
CONFIG_ARCH_BOARD_CUSTOM=y
CONFIG_ARCH_BOARD_CUSTOM_DIR="../../examples/out-of-tree-demo/boards/sim/sim/sim/"
CONFIG_ARCH_BOARD_CUSTOM_DIR_RELPATH=y
CONFIG_ARCH_BOARD_CUSTOM_NAME="sim"
CONFIG_ARCH_CHIP="sim"
CONFIG_ARCH_SIM=y
CONFIG_BOARDCTL_RESET=y
CONFIG_BOARDCTL_RESET_CAUSE=y
CONFIG_BOARDCTL_UNIQUEID=y
CONFIG_BOARD_LOOPSPERMSEC=0
CONFIG_BUILTIN=y
CONFIG_CXX_LOCALIZATION=y
CONFIG_DEBUG_ASSERTIONS=y
CONFIG_DEBUG_ASSERTIONS_EXPRESSION=y
CONFIG_DEBUG_FEATURES=y
CONFIG_DEBUG_SYMBOLS=y
CONFIG_DEFAULT_TASK_STACKSIZE=8192
CONFIG_EVENT_FD=y
CONFIG_FRAME_POINTER=y
CONFIG_FS_PROCFS=y
CONFIG_GPIO_LOWER_HALF=y
CONFIG_HAVE_CXX=y
CONFIG_IDLETHREAD_STACKSIZE=8192
CONFIG_INIT_ENTRYNAME="nsh_main"
CONFIG_INIT_ENTRYPOINT="nsh_main"
CONFIG_INIT_STACKSIZE=10240
CONFIG_INPUT=y
CONFIG_INPUT_BUTTONS=y
CONFIG_LIBCXX=y
CONFIG_LIBCXXABI=y
CONFIG_LIBC_FLOATINGPOINT=y
CONFIG_LIBC_HOSTNAME="dawnoot"
CONFIG_LIBC_LOCALE=y
CONFIG_NSH_BUILTIN_APPS=y
CONFIG_NSH_READLINE=y
CONFIG_PSEUDOTERM=y
CONFIG_SCHED_BACKTRACE=y
CONFIG_SCHED_HAVE_PARENT=y
CONFIG_SCHED_WAITPID=y
CONFIG_STACK_CANARIES=y
CONFIG_STACK_USAGE=y
CONFIG_START_MONTH=6
CONFIG_START_YEAR=2008
CONFIG_STDIO_BUFFER_SIZE=1024
CONFIG_STREAM_OUT_BUFFER_SIZE=1024
CONFIG_SYSTEM_NSH=y
CONFIG_TLS_NELEM=4
CONFIG_USERLED=y
CONFIG_USERLED_LOWER=y
#include "defconfig.dawn"
```

## examples/out-of-tree-demo/external/apps/Kconfig
```kconfig
#
# examples/out-of-tree-demo/external/apps/Kconfig
#
# SPDX-License-Identifier: Apache-2.0
#

source "$(DAWN_OOT_ROOT)/external/apps/hello_oot/Kconfig"
```

## examples/out-of-tree-demo/external/apps/hello_oot/Kconfig
```kconfig
#
# examples/out-of-tree-demo/external/apps/hello_oot/Kconfig
#
# SPDX-License-Identifier: Apache-2.0
#

config DAWN_OOT_DEMO_APP_HELLO
	bool "OOT demo: hello_oot NSH builtin"
	default n
	---help---
	  Build a tiny NuttX application that prints a banner. Demonstrates
	  the OOT custom-app extension point: the app is defined entirely in
	  the out-of-tree project and registered via nuttx_add_application
	  without any upstream Dawn changes.

if DAWN_OOT_DEMO_APP_HELLO

config DAWN_OOT_DEMO_APP_HELLO_STACKSIZE
	int "hello_oot stack size"
	default DEFAULT_TASK_STACKSIZE

endif
```

## examples/out-of-tree-demo/external/src/io/Kconfig
```kconfig
#
# examples/out-of-tree-demo/external/src/io/Kconfig
#
# SPDX-License-Identifier: Apache-2.0
#

config DAWN_OOT_DEMO_IO
	bool "OOT demo: custom IO classes"
	default n
	depends on DAWN
	---help---
	  Enable the demo's custom user-defined IO classes (CIOMyDummy)
	  and the user IO factory hook.
```

## examples/out-of-tree-demo/external/src/prog/Kconfig
```kconfig
#
# examples/out-of-tree-demo/external/src/prog/Kconfig
#
# SPDX-License-Identifier: Apache-2.0
#

config DAWN_OOT_DEMO_PROG
	bool "OOT demo: custom PROG classes"
	default n
	depends on DAWN
	---help---
	  Enable the demo's custom user-defined PROG classes (CProgMyEcho)
	  and the user PROG factory hook.
```

## examples/out-of-tree-demo/external/src/proto/Kconfig
```kconfig
#
# examples/out-of-tree-demo/external/src/proto/Kconfig
#
# SPDX-License-Identifier: Apache-2.0
#

config DAWN_OOT_DEMO_PROTO
	bool "OOT demo: custom PROTO classes"
	default n
	depends on DAWN
	---help---
	  Enable the demo's custom user-defined PROTO classes (CProtoMyHello)
	  and the user PROTO factory hook.
```
