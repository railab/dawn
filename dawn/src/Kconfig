## dawn/src/Kconfig
```kconfig
#
# For a description of the syntax of this configuration file,
# see the file kconfig-language.txt in the NuttX tools repository.
#

config DAWN
	bool "Dawn Framework"
	default n
	---help---
		Enable Dawn.

if DAWN

config DAWN_DEBUG_INFO
	bool "Dawn debug info messages"
	default n
	---help---
		Enable info messages for Dawn.

config DAWN_DEBUG_WARN
	bool "Dawn debug warn messages"
	default n
	---help---
		Enable warning messages for Dawn.

config DAWN_DEBUG_ERROR
	bool "Dawn debug ERROR messages"
	default n
	---help---
		Enable error messages for Dawn.

config DAWN_DESC_VALID
	bool "Dawn validate descriptor"
	default y
	---help---
		Enable additional descriptor checks.
		Can help detect simple errors in the descriptor, but at the moment
		it doesn't check much.

config DAWN_DESC_VALID_CRC32
	bool "Dawn validate descriptor checksum"
	default y
	---help---
		Use CRC32 checksum to validate the descriptor.
		When DAWN_DESC_SLOTS > 1, CRC is effectively mandatory for
		runtime descriptor switching safety.

config DAWN_DESC_SLOTS
	int "Dawn descriptor slots count"
	range 1 8
	default 1
	---help---
		Number of descriptor slots available at runtime.
		Slot 0 is the boot (FLASH/static) descriptor.
		Slots 1..N-1 are RAM upload slots.

config DAWN_DESC_SLOT_SIZE
	int "Dawn descriptor RAM slot size (bytes)"
	default 4096 if DAWN_DESC_SLOTS > 1
	default 0
	---help---
		Maximum size of one RAM descriptor slot in bytes.
			Total static RAM usage is approximately:
			(DAWN_DESC_SLOTS - 1) * DAWN_DESC_SLOT_SIZE.

config DAWN_DESC_SWITCH
	bool "Dawn runtime descriptor switching"
	default y
	depends on DAWN_DESC_SLOTS > 1 && DAWN_LIFECYCLE_TEARDOWN
	---help---
		Enable runtime descriptor slot switching support.
		When disabled, Dawn runs only the initially loaded descriptor.

config DAWN_LIFECYCLE_TEARDOWN
	bool "Enable object teardown (stop/deinit/delete)"
	default y
	---help---
		Enable Dawn teardown lifecycle logic:
		- stopAll() during shutdown paths
		- deinitAll() calls
		- object delete cleanup in generic handlers

		Disable for minimal systems that run indefinitely and never use
		shutdown/descriptor-switch teardown paths. This reduces runtime and
		allows linker garbage collection to drop unused teardown code.

config DAWN_OBJECT_HAS_NAME
	bool
	default n
	---help---
		Enable human-readable object names. When enabled, each object
		has a name in format "classname_instance" (e.g., "adc_0", "pwm_0").
		This is automatically selected by features that need it.

config DAWN_OBJECT_NAME_SIZE
	int "Object name buffer size"
	default 16
	depends on DAWN_OBJECT_HAS_NAME
	---help---
		Maximum length for object names (including null terminator).
		Names in format "classname_instance" must fit within this size.
		Default is 16 characters.

config DAWN_INSPECT
	bool
	select DAWN_OBJECT_HAS_NAME
	default n
	---help---
		Enable object inspection infrastructure. This is automatically
		selected by features that need it (e.g., Shell Inspector).
		Do not enable manually - use feature-specific options instead.

		When enabled, adds:
		- Runtime statistics tracking per object (~12 bytes/object)
		- Handler registration with CDevInspector
		- Read-only object iteration APIs

menu "Dawn dtype support"

config DAWN_DTYPE_BOOL
	bool "Enable DTYPE_BOOL support"
	default y

config DAWN_DTYPE_INT8
	bool "Enable DTYPE_INT8 support"
	default y

config DAWN_DTYPE_UINT8
	bool "Enable DTYPE_UINT8 support"
	default y

config DAWN_DTYPE_INT16
	bool "Enable DTYPE_INT16 support"
	default y

config DAWN_DTYPE_UINT16
	bool "Enable DTYPE_UINT16 support"
	default y

config DAWN_DTYPE_INT32
	bool "Enable DTYPE_INT32 support"
	default y

config DAWN_DTYPE_UINT32
	bool "Enable DTYPE_UINT32 support"
	default y

config DAWN_DTYPE_INT64
	bool "Enable DTYPE_INT64 support"
	default y

config DAWN_DTYPE_UINT64
	bool "Enable DTYPE_UINT64 support"
	default y

config DAWN_DTYPE_FLOAT
	bool "Enable DTYPE_FLOAT support"
	default y

config DAWN_DTYPE_DOUBLE
	bool "Enable DTYPE_DOUBLE support"
	default y

config DAWN_DTYPE_B16
	bool "Enable DTYPE_B16 support"
	default y

config DAWN_DTYPE_UB16
	bool "Enable DTYPE_UB16 support"
	default y

config DAWN_DTYPE_NUMERIC
	bool
	default y if DAWN_DTYPE_NUMERIC_INT || DAWN_DTYPE_NUMERIC_FLOAT
	default n

config DAWN_DTYPE_NUMERIC_INT
	bool
	default y if DAWN_DTYPE_INT8 || DAWN_DTYPE_UINT8
	default y if DAWN_DTYPE_INT16 || DAWN_DTYPE_UINT16
	default y if DAWN_DTYPE_INT32 || DAWN_DTYPE_UINT32
	default y if DAWN_DTYPE_INT64 || DAWN_DTYPE_UINT64
	default y if DAWN_DTYPE_B16 || DAWN_DTYPE_UB16
	default n

config DAWN_DTYPE_NUMERIC_FLOAT
	bool
	default y if DAWN_DTYPE_FLOAT || DAWN_DTYPE_DOUBLE
	default n

config DAWN_DTYPE_CHAR
	bool "Enable DTYPE_CHAR support"
	default y

config DAWN_DTYPE_BLOCK
	bool "Enable DTYPE_BLOCK support"
	default y

endmenu

source "$APPSDIR/external/dawn/src/io/Kconfig"
source "$APPSDIR/external/dawn/src/proto/Kconfig"
source "$APPSDIR/external/dawn/src/prog/Kconfig"

endif # DAWN
```

## dawn/src/io/Kconfig
```kconfig
#
# For a description of the syntax of this configuration file,
# see the file kconfig-language.txt in the NuttX tools repository.
#

config DAWN_IO
	bool "Dawn IO support"
	default y
	---help---
		Enable support for Dawn IOs.

if DAWN_IO

config DAWN_IO_HAS_STATS
	bool
	default y
	---help---
		Hidden option to enable IO statistics tracking (read/write/error
		counts). When enabled, CIOCommon tracks operation statistics that
		can be queried at runtime. This is independent of the inspect
		feature and can be disabled to reduce memory footprint.

config DAWN_IO_NOTIFY
	bool "Dawn IO notifications support"
	---help---
		Enable support for IO async notifications.

config DAWN_IO_NOTIFY_STREAM
	bool "Dawn IO stream notifications support"
	depends on DAWN_IO_NOTIFY
	default n
	---help---
		Enable stream-based IO notifications with a dedicated thread
		per IO object. Suitable for high-frequency data streaming
		where each IO needs its own thread and priority.

config DAWN_IO_TIMESTAMP
	bool "Dawn IO timestamp support"
	---help---
		Enable timestamp-aware IO support and timestamp-capable bindings.

config DAWN_IO_LIMITS
	bool "Dawn IO limits support"
	default y
	---help---
		Enable IO limit configuration support
		(IO_CFG_LIMIT_MIN/MAX/STEP). Disable to reduce RAM and code size
		when descriptor-defined runtime limits are not needed.

config DAWN_IO_SEEKABLE
	bool "Dawn seekable IO support"
	default n
	---help---
		Enable partial offset-based IO reads/writes for seekable IO objects.
		When disabled, offset-based access returns -ENOTSUP.

config DAWN_IO_CONFIG
	bool "Dawn Config IO support"
	default n
	---help---
		Enable the Config IO used for runtime configuration access.

config DAWN_IO_CONTROL
	bool "Dawn control IO support"
	default n
	---help---
		Enable the Control IO used to start and stop supported objects.

config DAWN_IO_TRIGGER
	bool "Dawn trigger IO support"
	default n
	---help---
		Enable the Trigger IO used to trigger supported object actions.

config DAWN_IO_DUMMY
	bool "Dawn Dummy IO support"
	default n
	---help---
		Enable the dummy IO implementation used for tests and placeholders.

config DAWN_IO_DUMMY_NOTIFY
	bool "Dawn timer-driven dummy IO support"
	select DAWN_IO_TIMERFD
	default n
	---help---
		Enable a timer-driven dummy IO that stores an in-memory value and
		emits periodic notifications.

config DAWN_IO_PRINT
	bool "Dawn Print IO support"
	default n
	---help---
		Enable the print IO for debug-oriented text output.

config DAWN_IO_VIRT
	bool "Dawn Virtual IO support"
	default n
	---help---
		Enable virtual IO objects used by programs and protocol bindings.

config DAWN_IO_SYSINFO
	bool "Dawn sysinfo IO support"
	default n
	depends on DAWN_DTYPE_FLOAT || DAWN_DTYPE_UB16
	---help---
		Enable sysinfo IO objects such as uptime and CPU load.

config DAWN_IO_BOARDCTL
	bool "Dawn boardctl IO support"
	default n
	---help---
		Enable board control IO objects such as reset and poweroff.

config DAWN_IO_UNAME
	bool "Dawn uname IO support"
	default n
	depends on DAWN_DTYPE_CHAR
	---help---
		Enable uname IO objects such as the system hostname.

config DAWN_IO_UUID
	bool "Dawn UUID IO support"
	default n
	depends on DAWN_DTYPE_UINT8
	---help---
		Enable support for UUID (unique device identifier) IO.

config DAWN_IO_SYSTIME
	bool "Dawn system time IO support"
	default n
	---help---
		Enable the system time IO for reading or exposing wall-clock time.

config DAWN_IO_SENSOR
	bool "Dawn Sensor IO support"
	default n
	depends on DAWN_DTYPE_FLOAT || DAWN_DTYPE_B16
	---help---
		Enable sensor-backed IO objects using the NuttX sensor framework.

config DAWN_IO_SENSOR_PRODUCER
	bool "Dawn Sensor producer IO support"
	default n
	depends on DAWN_DTYPE_FLOAT  || DAWN_DTYPE_B16
	---help---
		Enable write-only IO objects that publish Dawn protocol data into
		user sensor topics.

config DAWN_IO_ADC
	bool
	default n

config DAWN_IO_ADC_FETCH
	bool "Dawn ADC fetch IO support"
	default n
	depends on DAWN_DTYPE_INT32
	select DAWN_IO_ADC
	---help---
		Enable on-demand ADC fetch IO objects.

config DAWN_IO_ADC_SYNC
	bool "Dawn ADC sync IO support"
	default n
	depends on DAWN_DTYPE_INT32
	select DAWN_IO_ADC
	select DAWN_IO_NOTIFY
	---help---
		Enable hardware-triggered ADC sync IO objects.

config DAWN_IO_ADC_STREAM
	bool "Dawn ADC stream IO support"
	default n
	depends on DAWN_DTYPE_INT32
	select DAWN_IO_ADC
	select DAWN_IO_NOTIFY
	---help---
		Enable batch ADC stream IO objects.

config DAWN_IO_DAC
	bool "Dawn DAC IO support"
	default n
	depends on DAWN_DTYPE_INT32
	---help---
		Enable DAC-backed IO objects for analog output control.

config DAWN_IO_ENCODER
	bool "Dawn Encoder IO support"
	default n
	depends on DAWN_DTYPE_INT32
	---help---
		Enable quadrature encoder position IO objects.

config DAWN_IO_ENCODER_INDEX
	bool "Dawn Encoder Index IO support"
	default n
	depends on DAWN_DTYPE_INT32
	---help---
		Enable quadrature encoder IO objects exposing position and index data.

config DAWN_IO_GPO
	bool "Dawn GPO IO support"
	default n
	depends on DAWN_DTYPE_UINT32
	---help---
		Enable general-purpose output IO objects.

config DAWN_IO_GPI
	bool "Dawn GPI IO support"
	default n
	depends on DAWN_DTYPE_UINT32
	---help---
		Enable general-purpose input IO objects.

config DAWN_IO_PWM
	bool "Dawn PWM IO support"
	default n
	depends on DAWN_DTYPE_UINT32
	---help---
		Enable PWM-backed IO objects for duty-cycle control.

config DAWN_IO_PWM_DEFAULT_FREQ
	int "Dawn PWM default frequency"
	default 1000
	depends on DAWN_IO_PWM
	range 1 2147483647
	---help---
		Default PWM output frequency in Hz when a PWM IO descriptor does
		not provide an explicit freq field.

config DAWN_IO_BUTTONS
	bool "Dawn Buttons IO support"
	default n
	---help---
		Enable button input IO objects backed by board button drivers.

config DAWN_IO_LEDS
	bool "Dawn Leds IO support"
	default n
	---help---
		Enable LED output IO objects backed by board LED drivers.

config DAWN_IO_RGB_LED
	bool "Dawn RGB LED IO support"
	default n
	depends on DAWN_DTYPE_UINT32
	---help---
		Enable RGB LED output IO objects backed by /dev/rgbledN devices.
		Dawn values use DTYPE_UINT32 with 0x00RRGGBB encoding and are
		converted to the #RRGGBB string format expected by NuttX RGB LED
		drivers.

config DAWN_IO_TIMERFD
	bool
	default n
	---help---
		Internal helper for timer-backed IO implementations.

config DAWN_IO_TIMESTAMPIO
	bool "Dawn timestamp IO support"
	select DAWN_IO_TIMERFD
	default n
	---help---
		Enable timer-driven timestamp IO objects.

config DAWN_IO_RANDIO
	bool "Dawn rand IO support"
	select DAWN_IO_TIMERFD
	default n
	---help---
		Enable timer-driven random-number IO objects.

config DAWN_IO_DESCRIPTOR
	bool "Dawn descriptor IO support"
	default n
	depends on DAWN_IO_SEEKABLE
	---help---
		Enable read access to the loaded descriptor through an IO object.

config DAWN_IO_CAPABILITIES
	bool "Dawn capabilities IO support"
	default n
	depends on DAWN_IO_SEEKABLE
	depends on DAWN_DTYPE_BLOCK
	---help---
		Enable IO_CLASS_CAPABILITIES read-only seekable capability bitmap IO.

config DAWN_IO_DESC_SELECTOR
	bool "Dawn descriptor selector IO support"
	default n
	depends on DAWN_IO_DESCRIPTOR && DAWN_DESC_SWITCH
	depends on DAWN_DTYPE_UINT32
	---help---
		Enable IO_CLASS_DESC_SELECTOR runtime descriptor slot selection.

config DAWN_IO_FILE
	bool "Dawn File IO support"
	default n
	depends on DAWN_IO_SEEKABLE
	---help---
		Enable support for file system access via the Dawn IO abstraction.
		Access is restricted to the /data/ and /tmp/ directories.

endif # DAWN_IO
```

## dawn/src/porting/nuttx/Kconfig
```kconfig
#
# For a description of the syntax of this configuration file,
# see the file kconfig-language.txt in the NuttX tools repository.
#

config DAWN_NUTTX_BOARDS_COMPAT
	bool "Dawn compatible with NuttX upstream boards"
	default n
	---help---
		Enable compatibility helpers for upstream NuttX board layouts.
```
