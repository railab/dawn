## dawn/src/proto/nimble/Kconfig
```kconfig
#
# For a description of the syntax of this configuration file,
# see the file kconfig-language.txt in the NuttX tools repository.
#

config DAWN_PROTO_NIMBLE
	bool "Dawn NimBLE proto support"
	default n
	---help---
		Enable NimBLE-based protocol support in Dawn.

if DAWN_PROTO_NIMBLE

choice
	prompt "Dawn NimBLE role"
	default DAWN_PROTO_NIMBLE_PERIPHERAL

config DAWN_PROTO_NIMBLE_PERIPHERAL
	bool "Dawn NimBLE peripheral"
	---help---
		Build the NimBLE peripheral role.

endchoice # "Dawn NimBLE role"

if DAWN_PROTO_NIMBLE_PERIPHERAL

config DAWN_PROTO_NIMBLE_GAPNAME_MAX
	int "Dawn NimBLE maximum GAP name length"
	default 16
	range 1 26
	---help---
		Maximum advertised GAP device name length, excluding the trailing
		NUL byte. BLE legacy advertising data is limited to 31 bytes; with
		the flags AD structure and complete-name AD structure overhead, the
		maximum complete name that fits in the current advertising packet is
		26 bytes.

config DAWN_PROTO_NIMBLE_TPS
	bool "Dawn NimBLE enable Tx Power Service"
	default n
	---help---
		Enable the BLE Tx Power Service.

config DAWN_PROTO_NIMBLE_DIS
	bool "Dawn NimBLE Device Information Service support"
	default n
	---help---
		Enable the Device Information Service.

config DAWN_PROTO_NIMBLE_BAS
	bool "Dawn NimBLE Battery Service support"
	default n
	depends on DAWN_IO_NOTIFY
	---help---
		Enable the Battery Service. The Dawn BAS binding requires a
		notify-capable IO object for the battery level source.

config DAWN_PROTO_NIMBLE_AIOS
	bool "Dawn NimBLE Automation IO Service support"
	default n
	---help---
		Enable the Automation IO Service.

config DAWN_PROTO_NIMBLE_AIOS_AGGREGATE
	bool "Dawn NimBLE AIOS Aggregate characteristic"
	default n
	depends on DAWN_PROTO_NIMBLE_AIOS
	---help---
		Enable the optional AIOS Aggregate characteristic (0x2A5A),
		which returns the current values of readable AIOS Digital and
		Analog characteristics in one read.

config DAWN_PROTO_NIMBLE_EXTENDED_METADATA
	bool "Dawn NimBLE extended metadata descriptors"
	default y
	---help---
		Enable optional BLE descriptors attached to standard-service
		characteristics, such as Characteristic User Description, Valid
		Range, and Environmental Sensing Measurement. Disable this to
		reduce code size and runtime allocations when only the mandatory
		data characteristics are needed.

config DAWN_PROTO_NIMBLE_AIOS_DESC_USER_DESCRIPTION
	bool "Dawn NimBLE AIOS Characteristic User Description descriptor"
	default y
	depends on DAWN_PROTO_NIMBLE_AIOS && DAWN_PROTO_NIMBLE_EXTENDED_METADATA
	---help---
		Enable AIOS Characteristic User Description descriptors (0x2901)
		from per-binding metadata.

config DAWN_PROTO_NIMBLE_AIOS_DESC_NUMBER_OF_DIGITALS
	bool "Dawn NimBLE AIOS Number of Digitals descriptor"
	default y
	depends on DAWN_PROTO_NIMBLE_AIOS && DAWN_PROTO_NIMBLE_EXTENDED_METADATA
	---help---
		Enable AIOS Number of Digitals descriptors (0x2909) from
		per-binding metadata.

config DAWN_PROTO_NIMBLE_AIOS_DESC_VALUE_TRIGGER_SETTING
	bool "Dawn NimBLE AIOS Value Trigger Setting descriptor"
	default y
	depends on DAWN_PROTO_NIMBLE_AIOS && DAWN_PROTO_NIMBLE_EXTENDED_METADATA
	---help---
		Enable AIOS Value Trigger Setting descriptors (0x290A) backed by
		a referenced IO object that supplies the descriptor bytes.

config DAWN_PROTO_NIMBLE_AIOS_DESC_TIME_TRIGGER_SETTING
	bool "Dawn NimBLE AIOS Time Trigger Setting descriptor"
	default y
	depends on DAWN_PROTO_NIMBLE_AIOS && DAWN_PROTO_NIMBLE_EXTENDED_METADATA
	---help---
		Enable AIOS Time Trigger Setting descriptors (0x290E) backed by
		a referenced IO object that supplies the descriptor bytes.

config DAWN_PROTO_NIMBLE_AIOS_DESC_PRESENTATION_FORMAT
	bool "Dawn NimBLE AIOS Characteristic Presentation Format descriptor"
	default y
	depends on DAWN_PROTO_NIMBLE_AIOS && DAWN_PROTO_NIMBLE_EXTENDED_METADATA
	---help---
		Enable AIOS Characteristic Presentation Format descriptors
		(0x2904) from static per-binding metadata.

config DAWN_PROTO_NIMBLE_AIOS_DESC_EXTENDED_PROPERTIES
	bool "Dawn NimBLE AIOS Characteristic Extended Properties descriptor"
	default y
	depends on DAWN_PROTO_NIMBLE_AIOS && DAWN_PROTO_NIMBLE_EXTENDED_METADATA
	---help---
		Enable AIOS Characteristic Extended Properties descriptors
		(0x2900) from static per-binding metadata.

config DAWN_PROTO_NIMBLE_ESS
	bool "Dawn NimBLE Environmental Sensing Service support"
	default n
	---help---
		Enable the Environmental Sensing Service.

config DAWN_PROTO_NIMBLE_ESS_DESC_USER_DESCRIPTION
	bool "Dawn NimBLE ESS Characteristic User Description descriptor"
	default y
	depends on DAWN_PROTO_NIMBLE_ESS && DAWN_PROTO_NIMBLE_EXTENDED_METADATA
	---help---
		Enable ESS Characteristic User Description descriptors (0x2901)
		from per-characteristic metadata.

config DAWN_PROTO_NIMBLE_ESS_DESC_VALID_RANGE
	bool "Dawn NimBLE ESS Valid Range descriptor"
	default y
	depends on DAWN_PROTO_NIMBLE_ESS && DAWN_PROTO_NIMBLE_EXTENDED_METADATA
	---help---
		Enable ESS Valid Range descriptors (0x2906) from
		per-characteristic metadata.

config DAWN_PROTO_NIMBLE_ESS_DESC_MEASUREMENT
	bool "Dawn NimBLE ESS Measurement descriptor"
	default y
	depends on DAWN_PROTO_NIMBLE_ESS && DAWN_PROTO_NIMBLE_EXTENDED_METADATA
	---help---
		Enable ESS Measurement descriptors (0x290C) backed by referenced
		IO objects for configurable descriptor fields.

config DAWN_PROTO_NIMBLE_ESS_DESC_CONFIGURATION
	bool "Dawn NimBLE ESS Configuration descriptor"
	default y
	depends on DAWN_PROTO_NIMBLE_ESS && DAWN_PROTO_NIMBLE_EXTENDED_METADATA
	---help---
		Enable ESS Configuration descriptors (0x290B) backed by a
		referenced IO object that supplies descriptor bytes.

config DAWN_PROTO_NIMBLE_ESS_DESC_TRIGGER_SETTING
	bool "Dawn NimBLE ESS Trigger Setting descriptor"
	default y
	depends on DAWN_PROTO_NIMBLE_ESS && DAWN_PROTO_NIMBLE_EXTENDED_METADATA
	---help---
		Enable ESS Trigger Setting descriptors (0x290D) backed by a
		referenced IO object that supplies descriptor bytes.

config DAWN_PROTO_NIMBLE_IMDS
	bool "Dawn NimBLE Industrial Measurement Device Service support"
	default n
	---help---
		Enable the Industrial Measurement Device Service.

config DAWN_PROTO_NIMBLE_IMDS_DESC_USER_DESCRIPTION
	bool "Dawn NimBLE IMDS Characteristic User Description descriptor"
	default y
	depends on DAWN_PROTO_NIMBLE_IMDS && DAWN_PROTO_NIMBLE_EXTENDED_METADATA
	---help---
		Enable IMDS Characteristic User Description descriptors (0x2901)
		from per-measurement metadata.

config DAWN_PROTO_NIMBLE_OTS
	bool "Dawn NimBLE Object Transfer Service support"
	default n
	depends on DAWN_IO_SEEKABLE
	---help---
		Enable the Bluetooth SIG Object Transfer Service (0x1825) for
		bulk read/write of seekable IO objects (files, descriptor slots,
		capability blobs). Uses GATT for control points (OACP, OLCP)
		and an L2CAP CoC channel (PSM 0x0025) for the data path.

		The service exposes one or more seekable IOs as OTS Objects.
		IOs that are not seekable are rejected at descriptor parse time.

endif # DAWN_PROTO_NIMBLE_PERIPHERAL

config DAWN_PROTO_NIMBLE_DUMMY
	bool "Dawn NimBLE dummy implementation"
	default DAWN_TESTS
	---help---
		Use the dummy NimBLE backend for tests and non-BLE builds.

endif # DAWN_PROTO_NIMBLE
```

## dawn/src/proto/nxscope/Kconfig
```kconfig
#
# For a description of the syntax of this configuration file,
# see the file kconfig-language.txt in the NuttX tools repository.
#

config DAWN_PROTO_NXSCOPE
	bool "Dawn nxscope proto support"
	default n
	---help---
		Enable NxScope protocol support in Dawn.

if DAWN_PROTO_NXSCOPE

config DAWN_PROTO_NXSCOPE_DUMMY
	bool "Dawn nxscope dummy support"
	default n
	---help---
		Enable the dummy NxScope transport for testing.

config DAWN_PROTO_NXSCOPE_SERIAL
	bool "Dawn nxscope serial support"
	default n
	---help---
		Enable the serial NxScope transport.

config DAWN_PROTO_NXSCOPE_UDP
	bool "Dawn nxscope UDP support"
	depends on LOGGING_NXSCOPE_INTF_UDP
	default n
	---help---
		Enable the UDP NxScope transport.

config DAWN_PROTO_NXSCOPE_STREAMBUF_LEN
	int "nxscope stream buffer length"
	default 512
	---help---
		Set the stream buffer size used for outgoing NxScope frames.

config DAWN_PROTO_NXSCOPE_RXBUF_LEN
	int "nxscope RX buffer length"
	default 32
	---help---
		Set the receive buffer size for NxScope input.

config DAWN_PROTO_NXSCOPE_RX_PADDING
	int "nxscope RX padding"
	default 0
	---help---
		Reserve extra padding bytes in the NxScope RX buffer.

config DAWN_PROTO_NXSCOPE_CRIBUF_LEN
	int "nxscope critucal buffer length"
	default 0
	---help---
		Set the size of the critical-section helper buffer.

choice
	prompt "nxscope sampling method"
	default DAWN_PROTO_NXSCOPE_SAMPLE_THREAD if !DAWN_IO_NOTIFY
	default DAWN_PROTO_NXSCOPE_NOTIFY if DAWN_IO_NOTIFY

config DAWN_PROTO_NXSCOPE_SAMPLE_THREAD
	bool "nxscope sample thread"
	---help---
		Use a polling thread to sample and send NxScope data.

config DAWN_PROTO_NXSCOPE_NOTIFY
	bool "nxscope notify"
	depends on DAWN_IO_NOTIFY
	---help---
		Use IO notifications to stream NxScope data asynchronously.

endchoice # "nxscope sampling method"

if DAWN_PROTO_NXSCOPE_SERIAL

config DAWN_PROTO_NXSCOPE_SERIAL_PATH
	string "nxscope serial path"
	default "/dev/ttyUSB0"
	---help---
		Set the default serial device path for NxScope.

config DAWN_PROTO_NXSCOPE_SERIAL_BAUD
	int "nxscope serial baud"
	default 115200
	---help---
		Ignored if set to 0 (for example for RTT interface)

endif # DAWN_PROTO_NXSCOPE_SERIAL

if DAWN_PROTO_NXSCOPE_UDP

config DAWN_PROTO_NXSCOPE_UDP_PORT
	int "nxscope UDP local port"
	default 50000
	range 1 65535
	---help---
		Set the default local UDP port for NxScope.

endif # DAWN_PROTO_NXSCOPE_UDP

endif # DAWN_PROTO_NXSCOPE
```

## dawn/src/proto/serial/Kconfig
```kconfig
# dawn/src/proto/serial/Kconfig
#
# SPDX-License-Identifier: Apache-2.0
#

config DAWN_PROTO_SERIAL
	bool "Dawn Serial-simple proto support"
	default n
	---help---
		Enable the binary serial protocol implementation.

if DAWN_PROTO_SERIAL

config DAWN_PROTO_SERIAL_PATH
	string "Dawn Serial-simple serial port default path"
	default "/dev/ttyS1"
	---help---
		Set the default serial device path.

config DAWN_PROTO_SERIAL_BAUD
	int "Dawn Serial-simple serial port default baud"
	default 115200
	range 1200 921600
	---help---
		Set the default serial baudrate.

endif # DAWN_PROTO_SERIAL
```

## dawn/src/proto/shell/Kconfig
```kconfig
#
# For a description of the syntax of this configuration file,
# see the file kconfig-language.txt in the NuttX tools repository.
#

config DAWN_PROTO_SHELL
	bool "Dawn shell proto support"
	default n
	---help---
		Enable the interactive Dawn shell protocol.

if DAWN_PROTO_SHELL

config DAWN_PROTO_SHELL_PRETTY
	bool "Dawn shell-pretty proto support"
	default y
	---help---
		Enable the human-readable shell command frontend.

if DAWN_PROTO_SHELL_PRETTY

config DAWN_PROTO_SHELL_INSPECT
	bool "Enable Shell Object Inspector"
	select DAWN_INSPECT
	default n
	---help---
		Enable advanced object inspection commands in Dawn Shell:
		- list: Show all objects with filtering
		- inspect: Deep object introspection
		- find: Search objects by pattern
		- tree: Hierarchical object view
		- stats: Runtime statistics

		This adds approximately 2-4 KB to code size and enables
		per-object runtime statistics tracking (~12 bytes/object).

endif # DAWN_PROTO_SHELL_PRETTY

endif # DAWN_PROTO_SHELL
```

## dawn/src/proto/udp/Kconfig
```kconfig
# dawn/src/proto/udp/Kconfig
#
# SPDX-License-Identifier: Apache-2.0
#

config DAWN_PROTO_UDP
	bool "Dawn UDP-simple proto support"
	default n
	---help---
		Enable the UDP transport for the binary Dawn protocol.

if DAWN_PROTO_UDP

config DAWN_PROTO_UDP_PORT
	int "Dawn UDP-simple local port"
	default 50000
	range 1 65535
	---help---
		Set the default local UDP port.

endif # DAWN_PROTO_UDP
```

## dawn/src/proto/wakaama/Kconfig
```kconfig
#
# SPDX-License-Identifier: Apache-2.0
#
# For a description of the syntax of this configuration file,
# see the file kconfig-language.txt in the NuttX tools repository.
#

config DAWN_PROTO_WAKAAMA
	bool "Dawn Wakaama LwM2M protocol"
	default n
	depends on NETUTILS_WAKAAMA && WAKAAMA_CLIENT_MODE
	---help---
		Expose descriptor-bound Dawn IO objects as LwM2M resources through
		Eclipse Wakaama.

if DAWN_PROTO_WAKAAMA

config DAWN_PROTO_WAKAAMA_ENDPOINT
	string "Default LwM2M endpoint name"
	default "dawn-wakaama"

config DAWN_PROTO_WAKAAMA_SERVER_HOST
	string "Default LwM2M server host"
	default "192.168.8.1"

config DAWN_PROTO_WAKAAMA_SERVER_PORT
	int "Default LwM2M server UDP port"
	default 5683
	range 1 65535

config DAWN_PROTO_WAKAAMA_LOCAL_PORT
	int "Default local UDP port"
	default 56830
	range 1 65535

config DAWN_PROTO_WAKAAMA_LIFETIME
	int "Default LwM2M registration lifetime"
	default 300
	range 1 2147483647

config DAWN_PROTO_WAKAAMA_SHORT_SERVER_ID
	int "Default LwM2M short server ID"
	default 123
	range 1 65535

config DAWN_PROTO_WAKAAMA_DTLS_PSK
	bool "Enable Wakaama DTLS PSK transport"
	default n
	depends on CRYPTO_TINYDTLS
	---help---
		Enable coaps:// Wakaama server connections with TinyDTLS PSK.

config DAWN_PROTO_WAKAAMA_DEVICE_MANUFACTURER
	string "Default LwM2M Device manufacturer"
	default "Dawn"

config DAWN_PROTO_WAKAAMA_DEVICE_MODEL_NUMBER
	string "Default LwM2M Device model number"
	default "dawn"

config DAWN_PROTO_WAKAAMA_DEVICE_SERIAL_NUMBER
	string "Default LwM2M Device serial number"
	default "dawn"

config DAWN_PROTO_WAKAAMA_DEVICE_FIRMWARE_VERSION
	string "Default LwM2M Device firmware version"
	default "unknown"

config DAWN_PROTO_WAKAAMA_MEMORY_POOL_SIZE
	int "Wakaama fixed memory pool size"
	default 16384
	range 1024 1048576
	---help---
		Bytes reserved for Wakaama protocol allocations. Upstream Wakaama
		allocates during normal request handling, including read, discover,
		write, observe, registration, and bootstrap paths. Dawn routes those
		allocation hooks into this protocol-owned static arena instead of the
		system heap.

endif # DAWN_PROTO_WAKAAMA
```
