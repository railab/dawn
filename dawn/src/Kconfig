## dawn/src/prog/Kconfig
```kconfig
#
# For a description of the syntax of this configuration file,
# see the file kconfig-language.txt in the NuttX tools repository.
#

config DAWN_PROG
	bool "Dawn program support"
	depends on DAWN_IO
	default n
	---help---
		Enable support for Dawn Programs.

config DAWN_PROG_PROCESS
	bool
	default n
	---help---
		Internal helper selected by notify-driven processing programs.

config DAWN_PROG_THRESHOLD_ANY
	bool
	default n
	---help---
		Internal helper selected by threshold-family programs.

if DAWN_PROG

config DAWN_PROG_ADJUST
	bool "Dawn program adjust support"
	default n
	depends on DAWN_IO_VIRT
	depends on DAWN_DTYPE_INT32
	depends on DAWN_DTYPE_UINT32
	---help---
		Enable the Adjust program for linear value scaling.

config DAWN_PROG_DUMMY
	bool "Dawn program dummy support"
	depends on DAWN_IO_VIRT
	default n
	---help---
		Enable a no-op Dummy Program used for testing factory creation and
		as a descriptor binding placeholder.

config DAWN_PROG_GATEWAY
	bool "Dawn program gateway support"
	depends on DAWN_IO_VIRT
	default n
	---help---
		Enable support for the Gateway program, which bridges two Virtual
		I/O objects so that different protocols can share the same IO state.
		Supports both write-propagation (notify) and on-demand fetch access.

config DAWN_PROG_LATEST
	bool "Dawn program latest cache support"
	default n
	select DAWN_PROG_PROCESS
	depends on DAWN_IO_NOTIFY && DAWN_IO_VIRT
	---help---
		Enable support for the Latest program, which caches the latest
		notified sample into a Virtual I/O for fetch-based readers.

config DAWN_PROG_REDIRECT
	bool "Dawn program redirect support"
	depends on DAWN_IO_VIRT && DAWN_IO_NOTIFY
	default n
	---help---
		Enable support for the Redirect program, which routes data from
		notify-capable input IOs to output IOs. Use the Sampling program
		when fetch-based polling is needed.

config DAWN_PROG_MOVING_AVG
	bool "Dawn program moving average filter support"
	default n
	select DAWN_PROG_PROCESS
	depends on DAWN_IO_VIRT && DAWN_IO_NOTIFY
	depends on DAWN_DTYPE_NUMERIC
	---help---
		Enable support for a notify-driven moving average filter program.

config DAWN_PROG_IIR_FILTER
	bool "Dawn program IIR filter support"
	default n
	select DAWN_PROG_PROCESS
	depends on DAWN_IO_VIRT && DAWN_IO_NOTIFY
	depends on DAWN_DTYPE_NUMERIC
	---help---
		Enable support for a notify-driven first-order IIR filter program.

config DAWN_PROG_THRESHOLD
	bool "Dawn program threshold comparator support"
	default n
	select DAWN_PROG_PROCESS
	select DAWN_PROG_THRESHOLD_ANY
	depends on DAWN_IO_VIRT && DAWN_IO_NOTIFY
	depends on DAWN_DTYPE_NUMERIC
	depends on DAWN_DTYPE_BOOL
	---help---
		Enable support for a notify-driven threshold comparator program.

config DAWN_PROG_THRESHOLD_VALUE
	bool "Dawn program threshold value comparator support"
	default n
	select DAWN_PROG_PROCESS
	select DAWN_PROG_THRESHOLD_ANY
	depends on DAWN_IO_VIRT && DAWN_IO_NOTIFY
	depends on DAWN_DTYPE_NUMERIC
	depends on DAWN_DTYPE_BOOL
	---help---
		Enable support for a notify-driven threshold comparator that
		emits source values only when the alert condition is active.

config DAWN_PROG_BUFFER
	bool "Dawn program history buffer support"
	default n
	depends on DAWN_IO_VIRT && DAWN_IO_NOTIFY
	---help---
		Enable support for a notify-driven history buffer with selector
		and status channels exposed via virtual IOs.

config DAWN_PROG_STATS_MIN
	bool "Dawn program stats min support"
	default n
	select DAWN_PROG_PROCESS
	depends on DAWN_IO_VIRT && DAWN_IO_NOTIFY
	depends on DAWN_DTYPE_NUMERIC
	---help---
		Enable the stats-min program.

config DAWN_PROG_STATS_MAX
	bool "Dawn program stats max support"
	default n
	select DAWN_PROG_PROCESS
	depends on DAWN_IO_VIRT && DAWN_IO_NOTIFY
	depends on DAWN_DTYPE_NUMERIC
	---help---
		Enable the stats-max program.

config DAWN_PROG_STATS_AVG
	bool "Dawn program stats avg support"
	default n
	select DAWN_PROG_PROCESS
	depends on DAWN_IO_VIRT && DAWN_IO_NOTIFY
	depends on DAWN_DTYPE_NUMERIC
	---help---
		Enable the stats-average program.

config DAWN_PROG_STATS_SUM
	bool "Dawn program stats sum support"
	default n
	select DAWN_PROG_PROCESS
	depends on DAWN_IO_VIRT && DAWN_IO_NOTIFY
	depends on DAWN_DTYPE_NUMERIC
	---help---
		Enable the stats-sum program.

config DAWN_PROG_STATS_COUNT
	bool "Dawn program stats count support"
	default n
	select DAWN_PROG_PROCESS
	depends on DAWN_IO_VIRT && DAWN_IO_NOTIFY
	depends on DAWN_DTYPE_NUMERIC
	---help---
		Enable the stats-count program.

config DAWN_PROG_STATS_RMS
	bool "Dawn program stats rms support"
	default n
	select DAWN_PROG_PROCESS
	depends on DAWN_IO_VIRT && DAWN_IO_NOTIFY
	depends on DAWN_DTYPE_NUMERIC
	---help---
		Enable the stats-RMS program.

config DAWN_PROG_SAMPLING
	bool "Dawn program sampling"
	depends on DAWN_IO_VIRT
	default n
	---help---
		Enable the Sampling program for periodic fetch-based processing.

if DAWN_PROG_SAMPLING

config DAWN_PROG_SAMPLING_INTERVAL
	int "Dawn sampling default interval (microseconds)"
	default 1000
	---help---
		Default sampling interval in microseconds used when no interval
		is specified in the descriptor.

endif # DAWN_PROG_SAMPLING

config DAWN_PROG_SEQUENCER
	bool "Dawn program sequencer"
	default n
	---help---
		Enable a generic state sequencer program that periodically applies
		configured values to writable output IOs.

config DAWN_PROG_BITSPLIT
	bool "Dawn program bit splitter"
	default n
	select DAWN_PROG_PROCESS
	depends on DAWN_IO_VIRT && DAWN_IO_NOTIFY
	depends on DAWN_DTYPE_UINT32
	---help---
		Enable the BitSplit program, which demultiplexes individual bits
		from a uint32 input into separate virtual IO outputs.

config DAWN_PROG_TOGGLE
	bool "Dawn program toggle"
	default n
	select DAWN_PROG_PROCESS
	depends on DAWN_IO_VIRT && DAWN_IO_NOTIFY
	depends on DAWN_DTYPE_UINT32
	---help---
		Enable the Toggle program, which flips output between two values
		on each rising edge of the input.

config DAWN_PROG_COUNTER
	bool "Dawn program counter"
	default n
	select DAWN_PROG_PROCESS
	depends on DAWN_IO_VIRT && DAWN_IO_NOTIFY
	depends on DAWN_DTYPE_UINT32
	---help---
		Enable the Counter program, which increments a wrapped counter
		on each rising edge of the input.

config DAWN_PROG_SWITCH
	bool "Dawn program switch"
	default n
	depends on DAWN_IO_VIRT && DAWN_IO_NOTIFY
	depends on DAWN_DTYPE_UINT32
	---help---
		Enable the Switch program, a multi-input AND-gate that writes
		on/off commands to a target IO when all control inputs match.

config DAWN_PROG_EXPRESSION
	bool "Dawn program expression"
	default n
	select DAWN_PROG_PROCESS
	depends on DAWN_IO_VIRT && DAWN_IO_NOTIFY
	depends on DAWN_DTYPE_UINT32
	---help---
		Enable the Expression program, which applies arithmetic
		operations (shift, add, sub) to input values with a constant.

config DAWN_PROG_SELECTOR
	bool "Dawn program selector"
	default n
	depends on DAWN_IO_VIRT && DAWN_IO_NOTIFY
	depends on DAWN_DTYPE_UINT32
	---help---
		Enable the Selector program, which routes one of N data virtIO
		inputs to a target IO based on a control value.

config DAWN_PROG_BITPACK
	bool "Dawn program bit packer"
	default n
	depends on DAWN_IO_VIRT && DAWN_IO_NOTIFY
	depends on DAWN_DTYPE_UINT32
	---help---
		Enable the BitPack program, which combines multiple boolean
		virtIO inputs into a single uint32 bitmask output (inverse of
		BitSplit).

config DAWN_PROG_VECPACK
	bool "Dawn program vector packer"
	default n
	depends on DAWN_IO_VIRT && DAWN_IO_NOTIFY
	---help---
		Enable the VecPack program, which combines multiple IO values
		into one multidimensional output IO.

config DAWN_PROG_VECSPLIT
	bool "Dawn program vector splitter"
	default n
	depends on DAWN_IO_VIRT && DAWN_IO_NOTIFY
	---help---
		Enable the VecSplit program, which splits one multidimensional
		input IO into multiple output IO values.

config DAWN_PROG_MANYTOONE
	bool "Dawn program many-to-one bridge"
	default n
	depends on DAWN_IO_VIRT && DAWN_IO_NOTIFY
	---help---
		Enable a bridge that forwards the last changed input IO to one
		output IO.

config DAWN_PROG_ONETOMANY
	bool "Dawn program one-to-many bridge"
	default n
	depends on DAWN_IO_VIRT && DAWN_IO_NOTIFY
	---help---
		Enable a bridge that forwards one input IO to many output IOs.

config DAWN_PROG_IOMUX
	bool "Dawn program IO multiplexer"
	default n
	depends on DAWN_IO_VIRT && DAWN_IO_NOTIFY
	depends on DAWN_DTYPE_UINT32
	---help---
		Enable a scalar-control IO multiplexer that routes one selected
		input IO to one output IO.

config DAWN_PROG_IODEMUX
	bool "Dawn program IO demultiplexer"
	default n
	depends on DAWN_IO_VIRT && DAWN_IO_NOTIFY
	depends on DAWN_DTYPE_UINT32
	---help---
		Enable a scalar-control IO demultiplexer that routes one input IO
		to one selected output IO.


endif # DAWN_PROG
```

## dawn/src/proto/Kconfig
```kconfig
#
# For a description of the syntax of this configuration file,
# see the file kconfig-language.txt in the NuttX tools repository.
#

config DAWN_PROTO
	bool "Dawn proto support"
	default n
	---help---
		Enable support for Dawn Protocols.

if DAWN_PROTO

config DAWN_PROTO_DUMMY
	bool "Dawn proto dummy support"
	default n
	---help---
		Enable a no-op Dummy Protocol used for testing factory creation and
		as a descriptor binding placeholder.

source "$APPSDIR/external/dawn/src/proto/nxscope/Kconfig"
source "$APPSDIR/external/dawn/src/proto/nimble/Kconfig"
source "$APPSDIR/external/dawn/src/proto/can/Kconfig"
source "$APPSDIR/external/dawn/src/proto/modbus/Kconfig"
source "$APPSDIR/external/dawn/src/proto/shell/Kconfig"
source "$APPSDIR/external/dawn/src/proto/serial/Kconfig"
source "$APPSDIR/external/dawn/src/proto/udp/Kconfig"
source "$APPSDIR/external/dawn/src/proto/ipc/Kconfig"
source "$APPSDIR/external/dawn/src/proto/wakaama/Kconfig"

endif # DAWN_PROTO
```

## dawn/src/proto/can/Kconfig
```kconfig
#
# For a description of the syntax of this configuration file,
# see the file kconfig-language.txt in the NuttX tools repository.
#

config DAWN_PROTO_CAN
	bool "Dawn CAN-simple proto support"
	default n
	---help---
		Enable the CAN protocol implementation for Dawn.

if DAWN_PROTO_CAN

config DAWN_PROTO_CAN_NODEID
	int "Dawn CAN-simple default node ID"
	default 1
	---help---
		Default node ID added to CAN IDs in CAN protocol bindings.

config DAWN_PROTO_CAN_EXTID
	bool "Dawn CAN-simple EXTID support"
	default n
	---help---
		Enable support for extended 29-bit CAN identifiers.

config DAWN_PROTO_CAN_CANFD
	bool "Dawn CAN-simple CANFD support"
	default n
	---help---
		Enable CAN FD framing (data lengths beyond 8 bytes).

config DAWN_PROTO_CAN_RTR
	bool "Dawn CAN-simple RTR support"
	default n
	---help---
		Enable RTR-based read requests for simple CAN access methods.

config DAWN_PROTO_CAN_SIMPLE
	bool "Dawn CAN simple access methods"
	default y
	---help---
		Enable per-IO CAN ID access (push, simple read, simple write).

config DAWN_PROTO_CAN_SEG
	bool "Dawn CAN segmented access methods"
	default n
	---help---
		Enable segmented read/write for long payloads.

config DAWN_PROTO_CAN_SEG_TIMEOUT_US
	int "Dawn CAN segmented timeout (us)"
	default 1000000
	---help---
		Timeout for segmented transfers before state is reset.

config DAWN_PROTO_CAN_SINGLE_ID
	bool "Dawn CAN single-ID indexed access methods"
	default n
	---help---
		Enable indexed read/write using one CAN ID per IO group.

endif # DAWN_PROTO_CAN
```

## dawn/src/proto/ipc/Kconfig
```kconfig
# dawn/src/proto/ipc/Kconfig
#
# SPDX-License-Identifier: Apache-2.0
#

config DAWN_PROTO_IPC
	bool "Dawn IPC-simple proto support"
	default n
	depends on PIPES
	---help---
		Enable the FIFO-based local IPC transport for the binary Dawn
		protocol.

if DAWN_PROTO_IPC

config DAWN_PROTO_IPC_RX_PATH
	string "Dawn IPC receive FIFO default path"
	default "/var/pipe/dawn_rx"
	---help---
		Set the default FIFO path used by Dawn to receive commands.

config DAWN_PROTO_IPC_TX_PATH
	string "Dawn IPC transmit FIFO default path"
	default "/var/pipe/dawn_tx"
	---help---
		Set the default FIFO path used by Dawn to send responses.

endif # DAWN_PROTO_IPC
```

## dawn/src/proto/modbus/Kconfig
```kconfig
#
# For a description of the syntax of this configuration file,
# see the file kconfig-language.txt in the NuttX tools repository.
#

config DAWN_PROTO_MODBUS
	bool "Dawn MODBUS proto support"
	default n
	select NXMODBUS
	select NXMODBUS_SERVER
	---help---
		Enable Modbus protocol support in Dawn.
		This requires NxModbus library.

if DAWN_PROTO_MODBUS

config DAWN_PROTO_MODBUS_RTU
	bool "Dawn MODBUS RTU proto support"
	default n
	select NXMODBUS_RTU
	---help---
		Enable the Modbus RTU transport backend.
		This requires NxModbus RTU support.

if DAWN_PROTO_MODBUS_RTU

config DAWN_PROTO_MODBUS_RTU_PATH
	string "Modbus RTU path"
	default "/dev/ttyUSB0"
	---help---
		Set the default device path for Modbus RTU.

config DAWN_PROTO_MODBUS_RTU_BAUD
	int "Modbus RTU baud"
	default 115200
	---help---
		Ignored if set to 0 (for example for RTT interface)

config DAWN_PROTO_MODBUS_RTU_ADDR
	hex "Modbus RTU address"
	default 0x01
	---help---
		Modbus Slave address.

config DAWN_PROTO_MODBUS_RTU_PARITY
	hex "Modbus RTU parity"
	default 2
	---help---
		Modbus parity, 0 - none, 1 - odd, 2 - even

endif # DAWN_PROTO_MODBUS_RTU

config DAWN_PROTO_MODBUS_COIL
	bool "Dawn MODBUS coil register support"
	default y
	---help---
		Enable support for coil registers (read-write bits).
		Includes both individual (MODBUS_TYPE_COIL) and
		packed (MODBUS_TYPE_COIL_PACKED) coil types.

config DAWN_PROTO_MODBUS_DISCRETE
	bool "Dawn MODBUS discrete register support"
	default y
	---help---
		Enable support for discrete input registers (read-only bits).
		Includes both individual (MODBUS_TYPE_DISCRETE) and
		packed (MODBUS_TYPE_DISCRETE_PACKED) discrete types.

config DAWN_PROTO_MODBUS_INPUT
	bool "Dawn MODBUS input register support"
	default y
	---help---
		Enable support for input registers (read-only 16-bit words).

config DAWN_PROTO_MODBUS_HOLDING
	bool "Dawn MODBUS holding register support"
	default y
	---help---
		Enable support for holding registers (read-write 16-bit words).

config DAWN_PROTO_MODBUS_SEEKABLE
	bool "Dawn MODBUS seekable register support"
	default y
	depends on DAWN_PROTO_MODBUS_HOLDING
	---help---
		Enable support for seekable register windows over holding registers.
		Requires holding register support (DAWN_PROTO_MODBUS_HOLDING).

config DAWN_PROTO_MODBUS_TCP
	bool "Dawn MODBUS TCP proto support"
	default n
	select NXMODBUS_TCP
	---help---
		Enable the Modbus TCP transport backend.
		This requires NxModbus TCP support.

if DAWN_PROTO_MODBUS_TCP

config DAWN_PROTO_MODBUS_TCP_PORT
	int "Modbus TCP port"
	default 502
	---help---
		Set the default TCP port for Modbus TCP.

config DAWN_PROTO_MODBUS_TCP_ADDR
	hex "Modbus TCP unit address"
	default 0x01
	---help---
		Set default unit address for Modbus TCP.

endif # DAWN_PROTO_MODBUS_TCP

endif # DAWN_PROTO_MODBUS
```
